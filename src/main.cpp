// NOM DU PROGRAMME : Sonde_LED_PROTOTYPE
// REALISATION INFORMATIQUE : Mathieu Lepage
// DATE DE CREATION : 2020/10/24
// OBJET : Programme test permettant de flash une LED lorsqu'elle atteint une température critique

#include <WiFiManager.h>
WiFiManager wm;
#define WEBSERVER_H
#include <ESPAsyncWebServer.h>
#include <AsyncTCP.h>
#include <SPIFFS.h>
#include <SPI.h>
#include <Wire.h>
#include <Adafruit_GFX.h>
#include <Adafruit_SSD1306.h>
#include <Adafruit_I2CDevice.h>
#include <Adafruit_SPIDevice.h>
#include <OneWire.h>
#include <DallasTemperature.h>

AsyncWebServer server(80);

#define SCREEN_WIDTH 128 // OLED display width, in pixels
#define SCREEN_HEIGHT 64 // OLED display height, in pixels

// Declaration for an SSD1306 display connected to I2C (SDA, SCL pins)
Adafruit_SSD1306 display(SCREEN_WIDTH, SCREEN_HEIGHT, &Wire, -1);

const char *ssid = "ESP32AP";
const char *password = "devkit1234"; //"EFC5F27D674F";

const int LED = 2;        //La PIN GPIO de la LED
const int oneWireBus = 4; // La pin GPIO de connexion
bool ok;                  //flag de verif pour le range de température

// Initialisation d'une instance onewire
OneWire oneWire(oneWireBus);
// Passer la référence au sensor Dallas Temperature
DallasTemperature sensors(&oneWire);

const char *PARAM_TEMPERATURE = "inputTemperature"; //Paramètre de la température maximum de l'interface web

// Une page web HTML qui permet de handle un input field (inputTemperature)
const char index_html[] PROGMEM = R"rawliteral(
<!DOCTYPE html>
<html lang="fr">
 
<head>
    <title>Serveur ESP32</title>
    <meta name="viewport" content="width=device-width, initial-scale=1"charset="UTF-8" />
    <script>
      function submitMessage() {
        setTimeout(function(){ document.location.reload(false); }, 500);   
      }
    </script>
</head>
 
<body>
    <div>
        <form action="/get" target="hidden-form" style="border: 3px groove;padding: 0 20px 20px 20px;width: 350px;margin-bottom:20px;">
            <h2>Allumer la LED avec une température</h2>
            <img style="width:250px;" src="https://previews.123rf.com/images/andegro4ka/andegro4ka1602/andegro4ka160200057/51562236-weather-thermometer-isolated-on-white-photo-realistic-vector-illustration.jpg" alt="imageThermometre">
            <br>
              Veuillez entrer une température : <input type="number" min="24" max=32" value="%inputTemperature%" name="inputTemperature" onchange="this.form.submit();submitMessage();">
            <br><br><br>
            <!-- onchange="this.form.submit();submitMessage();" TO SUBMIT WITH SELECT -->
            <!-- <input type="submit" value="Appliquer" onclick="submitMessage()"> -->
        </form>
    </div>
    <iframe style="display:none" name="hidden-form"></iframe>
</body>
</html>)rawliteral";

void notFound(AsyncWebServerRequest *request)
{
  request->send(404, "text/plain", "Not found");
}

// Fonction qui permet de lire une valeur encapsulée dans un fichier .txt
String readFile(fs::FS &fs, const char *path)
{
  //Serial.printf("Reading file: %s\r\n", path);
  File file = fs.open(path, "r");
  if (!file || file.isDirectory())
  {
    Serial.println("- empty file or failed to open file");
    return String();
  }
  String fileContent;
  while (file.available())
  {
    fileContent += String((char)file.read());
  }
  return fileContent;
}

// Fonction qui permet d'encapsuler une valeur dans un fichier .txt
void writeFile(fs::FS &fs, const char *path, const char *message)
{
  Serial.printf("Writing file: %s\r\n", path);
  File file = fs.open(path, "w");
  if (!file)
  {
    Serial.println("- failed to open file for writing");
    return;
  }
  if (file.print(message))
  {
    Serial.println("- file written");
  }
  else
  {
    Serial.println("- write failed");
  }
}

// Fonction qui permet de remplacer les placeholder entre % dans la page HTML par les valeurs stockées
String processor(const String &var)
{
  //Serial.println(var);
  if (var == "inputTemperature")
  {
    return readFile(SPIFFS, "/temperatureMax.txt");
  }
  return String();
}

// Hidden IF currentTemp < tempMax ELSE displayed
const unsigned char myBitmap[] PROGMEM = {
    0xff, 0xff, 0xff, 0xff, 0xff, 0xff, 0xff, 0xff, 0xff, 0xff, 0xff, 0xff, 0xff, 0xff, 0xff, 0xff,
    0xff, 0xff, 0xff, 0xff, 0xff, 0xff, 0xff, 0xff, 0xff, 0xff, 0xff, 0xff, 0xff, 0xff, 0xff, 0xff,
    0xff, 0xff, 0xff, 0xff, 0xff, 0xff, 0xff, 0xff, 0xff, 0xff, 0xff, 0xff, 0xff, 0xff, 0xff, 0xff,
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    0xff, 0xff, 0xff, 0xff, 0xff, 0xff, 0xff, 0xff, 0xff, 0xff, 0xff, 0xff, 0xff, 0xff, 0xff, 0xff};

//Fonction qui permet d'aller toujours chercher la dernière Température Max à jour
float getTempMax()
{
  float temperature = readFile(SPIFFS, "/temperatureMax.txt").toFloat();
  return temperature;
}

// Fonction qui permet d'aller chercher une température avec le senseur
float demanderTemperature()
{
  // On appelle la requète de température sensors.requestTemperatures()
  sensors.requestTemperatures();
  return sensors.getTempCByIndex(0);
}

// Fonction qui permet d'afficher les informations sur l'OLED
void afficherOLED()
{
  display.clearDisplay();
  display.setTextSize(1);
  display.setTextColor(WHITE);
  display.setCursor(0, 5);
  // Display static text
  display.print("Temp. limite : ");
  display.println(getTempMax());
  display.setCursor(0, 20);
  // Display static text
  display.print("Temp. actuel : ");
  display.println(demanderTemperature());
  if (demanderTemperature() > getTempMax())
  {
    display.setCursor(35, 45);
    display.print("WARNING!!!");
    //display.drawBitmap(0, 0, myBitmap, 128, 64, WHITE);
  }
  display.display();
}

// Vérifie si la température est dans le range permis : IF TRUE; LED: OFF ELSE; LED ON
void verifierTemperature()
{
  if (demanderTemperature() <= getTempMax() - 1)
  {
    ok = true;
  }

  if (demanderTemperature() <= getTempMax() && ok)
  {
    digitalWrite(LED, HIGH);
  }
  else
  {
    digitalWrite(LED, LOW);
    ok = false;
  }

  // while (demanderTemperature() > getTempMax())
  // {
  //   digitalWrite(LED, HIGH);
  //   delay(300);
  //   digitalWrite(LED, LOW);
  //   delay(700);
  //   afficherOLED();
  //   Serial.print("Celsius temperature: ");
  //   Serial.println(demanderTemperature());
  // }   
}

// Permet de factory reset les paramètres de l'ESP32
// void resetSetting()
// {
//   Serial.println("Suppression des reglages et redemarrage...");
//   wm.resetSettings();
//   ESP.restart();
//   delay(30000);
// }

void setup()
{
  Serial.begin(9600);   //Initialisation du serial monitor
  pinMode(LED, OUTPUT); //Définition de la LED en OUTPUT

  //Initialisation de l'OLED
  if (!display.begin(SSD1306_SWITCHCAPVCC, 0x3C))
  { // Address 0x3D for 128x64
    Serial.println(F("SSD1306 allocation failed"));
    for (;;)
      ;
  }
  delay(2000);

  // Initialisation du WiFi-Manager
  WiFi.mode(WIFI_STA);
  if (!wm.autoConnect(ssid, password))
    Serial.println("Erreur de connexion.");
  else
    Serial.println("Connexion etablie!");

  Serial.println();
  Serial.print("IP Address: ");
  Serial.println(WiFi.localIP());

  //Initialisaton du senseur de température
  sensors.begin();

  // Initialisation du SPIFFS
  if (!SPIFFS.begin(true))
  {
    Serial.println("An Error has occurred while mounting SPIFFS");
    return;
  }

  // Envoie la web page à l'utilisateur
  server.on("/", HTTP_GET, [](AsyncWebServerRequest *request) {
    request->send_P(200, "text/html", index_html, processor);
  });

  // Envoie une GET request à <ESP_IP>/get?inputString=<inputMessage>
  server.on("/get", HTTP_GET, [](AsyncWebServerRequest *request) {
    String inputMessage;
    // GET inputTest
    if (request->hasParam(PARAM_TEMPERATURE))
    {
      inputMessage = request->getParam(PARAM_TEMPERATURE)->value();
      writeFile(SPIFFS, "/temperatureMax.txt", inputMessage.c_str());
    }
    else
    {
      inputMessage = "No message sent";
    }
    Serial.println(inputMessage);
    request->send(200, "text/text", inputMessage);
  });
  server.onNotFound(notFound);
  // Fonction qui démarre le serveur local
  server.begin();
}

void loop()
{
  Serial.print("Celsius temperature: ");
  Serial.println(demanderTemperature());
  // Fonction qui permet d'afficher les informations sur l'OLED
  afficherOLED();
  // Allume la LED et affiche une image "WARNING" sur l'OLED si la température dépasse la temp. max
  verifierTemperature();
  delay(1000);
}